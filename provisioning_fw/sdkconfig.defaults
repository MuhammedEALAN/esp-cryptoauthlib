## provisioning_fw/sdkconfig.defaults
```kconfig
# CONFIG_TASK_WDT_TIMEOUT_S=60
# CONFIG_ESPTOOLPY_FLASHSIZE_8MB=y
# CONFIG_PARTITION_TABLE_OFFSET=0xc000
# CONFIG_FLASHMODE_QIO=y
# CONFIG_ESPTOOLPY_FLASHFREQ_80M=y
# CONFIG_ESP32_DEFAULT_CPU_FREQ_240=y
# CONFIG_NEWLIB_NANO_FORMAT=y
# CONFIG_ESP_SYSTEM_PANIC_PRINT_HALT=y
# CONFIG_FREERTOS_UNICORE=y
# CONFIG_COMPILER_OPTIMIZATION_SIZE=y
# CONFIG_APP_BUILD_TYPE_ELF_RAM=y
# CONFIG_COMPILER_OPTIMIZATION_ASSERTIONS_SILENT=y
# CONFIG_COMPILER_OPTIMIZATION_CHECKS_SILENT=y
CONFIG_ATECC608A_TCUSTOM=y
CONFIG_ATCA_MBEDTLS_ECDSA=y
CONFIG_ATCA_MBEDTLS_ECDSA_SIGN=y
CONFIG_ATCA_MBEDTLS_ECDSA_VERIFY=y
CONFIG_ATCA_I2C_SDA_PIN=2
CONFIG_ATCA_I2C_SCL_PIN=15
CONFIG_ATCA_I2C_ADDRESS=0xC0

# CONFIG_FREERTOS_PLACE_FUNCTIONS_INTO_FLASH=y
# CONFIG_RINGBUF_PLACE_FUNCTIONS_INTO_FLASH=y
# CONFIG_FREERTOS_PLACE_SNAPSHOT_FUNS_INTO_FLASH=y
# CONFIG_ESP_EVENT_POST_FROM_IRAM_ISR=n
# CONFIG_SPI_MASTER_ISR_IN_IRAM=n
# CONFIG_ESP32_REV_MIN_3=y
# CONFIG_ESP32_REV_MIN=3
# CONFIG_ESP_EVENT_POST_FROM_IRAM_ISR=n
# CONFIG_SPI_MASTER_ISR_IN_IRAM=n
# CONFIG_HAL_DEFAULT_ASSERTION_LEVEL=0
```
